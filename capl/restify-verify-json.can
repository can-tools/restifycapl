/*@!Encoding:1250*/
includes
{
  #include ".\includes\includes.cin"
}

variables
{
  char gJsonText[512] = "{\"name\":\"restify\",\"count\":42,\"ratio\":1.5,\"active\":true,\"note\":null,\"nested\":{\"id\":7,\"label\":\"inner\"},\"list\":[10,\"two\",false],\"emptyObject\":{},\"emptyArray\":[]}";
  char gUrlJson[128] = "https://httpbin.org/json";
  char gNoHeaders[1] = "";
  char gPath[32] = "/list/1";
  char gPathName[32] = "/name";
  char gTextApostrophe[64] = "{'name':'restify','value':1}";
  char gTextEscapedTwin[64] = "{\"name\":\"restify\",\"value\":1}";
  char gTextFormA[96] = "{'name':'restify','note':\"it's ok\"}";
  char gTextFormB[96] = "{'name':'restify','note':'it\\'s ok'}";
  char gTextAmbiguous[32] = "{'note':'it's'}";
  char gPathNote[32] = "/note";
  char gBody[8192];
  char gValue[64];
  char gSmallValue[4];
  dword gDocId = 0;
  char gTypedText[256] = "{\"int\":42,\"frac\":2.5,\"whole\":5.0,\"max\":2147483647,\"over\":2147483648,\"flag\":true,\"off\":false,\"none\":null,\"numText\":\"42\",\"list\":[1,2,3],\"obj\":{\"a\":1}}";
  dword gTypedDocId = 0;
  char gTypedInt[16] = "/int";
  char gTypedFrac[16] = "/frac";
  char gTypedWhole[16] = "/whole";
  char gTypedMax[16] = "/max";
  char gTypedOver[16] = "/over";
  char gTypedFlag[16] = "/flag";
  char gTypedOff[16] = "/off";
  char gTypedNone[16] = "/none";
  char gTypedNumText[16] = "/numText";
  char gTypedList[16] = "/list";
  char gTypedObj[16] = "/obj";
  char gTypedMissing[16] = "/missing";
}

void verifyReport(char what[], long rc)
{
  char name[40];
  restLibStatusText(rc, name);
  write("%s: status %ld (%s)", what, rc, name);
}

void verifyOpenAndDump(char text[])
{
  long rc;
  dword count;

  if (gDocId != 0)
  {
    restLibJsonDiscardDocument(gDocId);
    gDocId = 0;
  }
  rc = restLibJsonParse(text, gDocId);
  verifyReport("parse", rc);
  if (rc != 0)
  {
    return;
  }
  rc = restLibJsonCountEntries(gDocId, count);
  verifyReport("count entries", rc);
  write("  document %lu has %lu entries", gDocId, count);
  restLibJsonDump(gDocId);
}

void verifyParseDumpDiscard(char what[], char bodyText[])
{
  long resultCode;
  dword tempId;

  resultCode = restLibJsonParse(bodyText, tempId);
  verifyReport(what, resultCode);
  if (resultCode != 0)
  {
    return;
  }
  restLibJsonDump(tempId);
  verifyReport("discard", restLibJsonDiscardDocument(tempId));
}

void verifyParseReadNote(char what[], char bodyText[])
{
  long resultCode;
  long valueType;
  dword tempId;

  resultCode = restLibJsonParse(bodyText, tempId);
  verifyReport(what, resultCode);
  if (resultCode != 0)
  {
    return;
  }
  resultCode = restLibJsonReadValue(tempId, gPathNote, gValue, valueType);
  verifyReport("read value", resultCode);
  if (resultCode == 0)
  {
    write("  %s = %s (type %ld), expected: it's ok", gPathNote, gValue, valueType);
  }
  verifyReport("discard", restLibJsonDiscardDocument(tempId));
}

void verifyTypedLong(char path[], long expectedStatus)
{
  long rc;
  long value;

  rc = restLibJsonReadLong(gTypedDocId, path, value);
  verifyReport("read long", rc);
  write("  %s = %ld, expected status %ld", path, value, expectedStatus);
}

void verifyTypedDouble(char path[], long expectedStatus)
{
  long rc;
  float value;

  rc = restLibJsonReadDouble(gTypedDocId, path, value);
  verifyReport("read double", rc);
  write("  %s = %f, expected status %ld", path, value, expectedStatus);
}

void verifyTypedBool(char path[], long expectedStatus)
{
  long rc;
  long value;

  rc = restLibJsonReadBool(gTypedDocId, path, value);
  verifyReport("read bool", rc);
  write("  %s = %ld, expected status %ld", path, value, expectedStatus);
}

void verifyTypedCount(char path[], long expectedStatus)
{
  long rc;
  dword elementCount;

  rc = restLibJsonCountElements(gTypedDocId, path, elementCount);
  verifyReport("count elements", rc);
  write("  %s has %lu elements, expected status %ld", path, elementCount, expectedStatus);
}

on start
{
  char version[64];
  long rc;

  rc = restLibReadVersion(version);
  if (rc == 0)
  {
    write("restify DLL version: %s", version);
  }
  else
  {
    verifyReport("restLibReadVersion", rc);
  }
}

on key '1'
{
  verifyOpenAndDump(gJsonText);
}

on key '2'
{
  long rc;
  long valueType;

  rc = restLibJsonReadValue(gDocId, gPath, gValue, valueType);
  verifyReport("read value", rc);
  if (rc == 0)
  {
    write("  %s = %s (type %ld)", gPath, gValue, valueType);
  }
}

on key '3'
{
  long rc;
  long httpStatus;
  dword bodyLength;

  rc = restLibGetSync(gUrlJson, gNoHeaders, gBody, httpStatus, bodyLength);
  verifyReport("sync GET", rc);
  write("  HTTP %ld, body %lu bytes", httpStatus, bodyLength);
  if (rc == 0)
  {
    verifyOpenAndDump(gBody);
  }
}

on key '4'
{
  long rc;
  long valueType;

  rc = restLibJsonReadValue(gDocId, gPathName, gSmallValue, valueType);
  verifyReport("read value, small buffer", rc);
  if (rc == -2)
  {
    rc = restLibJsonReadValue(gDocId, gPathName, gValue, valueType);
    verifyReport("read value, larger buffer", rc);
    if (rc == 0)
    {
      write("  %s = %s (type %ld)", gPathName, gValue, valueType);
    }
  }
}

on key '5'
{
  long rc;
  long i;
  dword id;
  dword discarded;

  restLibJsonDiscardAllDocuments(discarded);
  gDocId = 0;
  for (i = 0; i < 9; i++)
  {
    rc = restLibJsonParse(gJsonText, id);
    write("open document %ld: status %ld, id %lu", i + 1, rc, id);
  }
}

on key '6'
{
  long rc;
  dword id;

  rc = restLibJsonParse(gJsonText, id);
  verifyReport("parse", rc);
  if (rc != 0)
  {
    return;
  }
  verifyReport("first discard", restLibJsonDiscardDocument(id));
  verifyReport("second discard", restLibJsonDiscardDocument(id));
}

on key '7'
{
  dword discarded;
  long rc;

  rc = restLibJsonDiscardAllDocuments(discarded);
  gDocId = 0;
  verifyReport("discard all documents", rc);
  write("  discarded: %lu", discarded);
}

on key '8'
{
  verifyParseDumpDiscard("parse apostrophe text", gTextApostrophe);
  verifyParseDumpDiscard("parse escaped twin", gTextEscapedTwin);
}

on key '9'
{
  verifyParseReadNote("parse form A", gTextFormA);
  verifyParseReadNote("parse form B", gTextFormB);
}

on key '0'
{
  long resultCode;
  dword tempId;

  resultCode = restLibJsonParse(gTextAmbiguous, tempId);
  verifyReport("parse ambiguous text (expected -10)", resultCode);
  if (resultCode == 0)
  {
    restLibJsonDiscardDocument(tempId);
  }
}

on key 'a'
{
  long rc;

  restLibJsonDiscardDocument(gTypedDocId);
  gTypedDocId = 0;
  rc = restLibJsonParse(gTypedText, gTypedDocId);
  verifyReport("parse typed document", rc);
}

on key 'b'
{
  write("read long: 42, 5, 2147483647, then -16, -17, -14, -14, -15, -12");
  verifyTypedLong(gTypedInt, 0);
  verifyTypedLong(gTypedWhole, 0);
  verifyTypedLong(gTypedMax, 0);
  verifyTypedLong(gTypedOver, -16);
  verifyTypedLong(gTypedFrac, -17);
  verifyTypedLong(gTypedNumText, -14);
  verifyTypedLong(gTypedFlag, -14);
  verifyTypedLong(gTypedNone, -15);
  verifyTypedLong(gTypedMissing, -12);
}

on key 'c'
{
  write("read double: 42, 2.5, 5, then -14, -15");
  verifyTypedDouble(gTypedInt, 0);
  verifyTypedDouble(gTypedFrac, 0);
  verifyTypedDouble(gTypedWhole, 0);
  verifyTypedDouble(gTypedNumText, -14);
  verifyTypedDouble(gTypedNone, -15);
}

on key 'd'
{
  write("read bool: 1, 0, then -14, -15");
  verifyTypedBool(gTypedFlag, 0);
  verifyTypedBool(gTypedOff, 0);
  verifyTypedBool(gTypedInt, -14);
  verifyTypedBool(gTypedNone, -15);
}

on key 'e'
{
  write("count elements: 3, then -14, -14, -15");
  verifyTypedCount(gTypedList, 0);
  verifyTypedCount(gTypedObj, -14);
  verifyTypedCount(gTypedInt, -14);
  verifyTypedCount(gTypedNone, -15);
}

on key 'f'
{
  verifyReport("discard typed document", restLibJsonDiscardDocument(gTypedDocId));
  gTypedDocId = 0;
}

on stopMeasurement
{
  dword discarded;
  dword stillRunning;

  restLibJsonDiscardAllDocuments(discarded);
  restLibDiscardAllResponses(stillRunning);
  gDocId = 0;
}
